## share/west.yml
```yaml
manifest:

  remotes:
    - name: zephyr
      url-base: https://github.com/zephyrproject-rtos

  projects:
    - name: zephyr
      remote: zephyr
      repo-path: zephyr
      revision: main
      import: true
      import:
        name-allowlist:
          - cmsis
          - hal_stm32
          - hal_espressif
```
